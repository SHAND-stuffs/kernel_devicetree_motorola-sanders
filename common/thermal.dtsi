&soc {
        sys_temp_support {
                compatible = "mmi,sys-temp";
                mmi,temperature-names = "front_temp",
                                        "back_temp";
                status = "ok";
        };
};

&pm8953_vadc {
	chan@13 {
		label = "msm_therm";
	};
};
