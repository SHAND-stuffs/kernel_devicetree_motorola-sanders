/* Moto */

#include "qcom/msm8953.dtsi"

#include "qcom/pmi8950.dtsi"

#include "qcom/msm8953-pinctrl.dtsi

#include "carrier-channel-ids.dtsi"
#include "include/moto-mem-reserve.h"

/* Custom */

#include "android.dtsi"
#include "pmi8950.dtsi"
#include "reserved-memory.dtsi"
#include "soc.dtsi"
#include "storage.dtsi"
#include "thermal.dtsi"
