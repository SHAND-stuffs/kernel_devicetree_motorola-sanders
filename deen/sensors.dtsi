&soc {
		sar_abov:abov@20 {
			compatible = "abov,abov_sar";
			reg = <0x20>;
			label = "AbovCapSense";
			cap_vdd-supply = <&pm8953_l10>;
			cap_svdd-supply = <&pm8953_l5>;
			interrupt-parent = <&tlmm>;
			interrupts = <86 0x2008>;
			gpios = <&tlmm 86 0x2008>; /* IRQ */
			pinctrl-names = "default";
			pinctrl-0 = <&abov_int_default>;
			cap,use_channel_top = <0x01>;
			cap,use_channel_bottom = <0x00>;
			reg_array_len = <0>;
			reg_array_val = <>;
		};

		sx9310@28 {
			compatible = "semtech,sx9310";
			reg = <0x28>;
			cap_vdd-supply = <&pm8953_l10>;
			cap_svdd-supply = <&pm8953_l5>;
			interrupt-parent = <&tlmm>;
			interrupts = <86 0x2008>;
			gpios = <&tlmm 86 0x2008>; /* IRQ */
			pinctrl-names = "default";
			pinctrl-0 = <&sx9310_int_default>;
			cap,use_channel = <0x0f>;
			cap,use_channel_top = <0x02>;
			cap,use_channel_bottom = <0x01>;
			cap,raw_data_channel = <0x01>;
			cap,scan_period = <0x00>;
			reg_array_len = <12>;
			reg_array_val = <0x10 0x0f
					0x12 0x0b
					0x13 0x0F
					0x15 0xc3
					0x17 0x4a
					0x18 0x51
					0x19 0x51
					0x1a 0x18
					0x21 0x18
					0x22 0x09
					0x23 0x15
					0x2a 0x01>;
	};
};
