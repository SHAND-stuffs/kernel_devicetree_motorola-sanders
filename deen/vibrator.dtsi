&pmi_haptic {
	qcom,lra-auto-res-mode="qwd";
	qcom,lra-high-z="opt1";
	qcom,lra-res-cal-period = <0>;
	qcom,wave-play-rate-us = <4878>;
	qcom,vmax-mv = <2600>;
	qcom,vmax-low-mv = <2600>;
	qcom,ilim-ma = <100>;
	qcom,brake-pattern = [03 03 03 00];
};
